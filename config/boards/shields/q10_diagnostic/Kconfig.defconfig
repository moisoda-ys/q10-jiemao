## config/boards/shields/q10_dongle/Kconfig.shield
```kconfig
# Copyright (c) 2026
# SPDX-License-Identifier: MIT

config SHIELD_Q10_DONGLE
    def_bool $(shields_list_contains,q10_dongle)
```

## config/west.yml
```yaml
manifest:
  remotes:
    - name: zmkfirmware
      url-base: https://github.com/zmkfirmware
    - name: moisoda-ys
      url-base: https://github.com/moisoda-ys
  projects:
    - name: zmk
      remote: zmkfirmware
      revision: v0.3.0
      import: app/west.yml
    - name: zmk-dongle-display
      remote: moisoda-ys
      revision: q10-large-status
  self:
    path: config
```
